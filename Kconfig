## Kconfig
```kconfig
# SPDX-FileCopyrightText: 2026 roolrz
# SPDX-License-Identifier: Apache-2.0

config SYSTEM_APP_FREE
    bool "free (/bin/free)"
    default y
    help
        Build and deploy hyper-free at /bin/free.
```
